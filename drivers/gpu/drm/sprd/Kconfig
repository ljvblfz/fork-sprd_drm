## drivers/gpu/drm/sprd/Kconfig
```kconfig
config DRM_SPRD
	tristate "DRM Support for Spreadtrum SoCs Platform"
	depends on DRM && OF && ARM64
	select DRM_KMS_HELPER
	select DRM_GEM_CMA_HELPER
	select DRM_KMS_CMA_HELPER
	select DRM_SPRD_DSI
	help
	  Choose this option if you have a Spreadtrum chipsets.
	  If M is selected the module will be called kirin-drm.

config DRM_SPRD_DSI
	tristate "Spreadtrum specific extensions for MIPI DSI Controller"
	depends on DRM_SPRD
	select DRM_MIPI_DSI
	select DRM_PANEL
	help
	 This selects support for Spreadtrum SoC specific extensions for
	 the DSI driver. If you want to enable MIPI DSI on Spreadtrum SoC,
	 you should selet this option.

config DRM_SPRD_PANEL
	tristate "Spreadtrum Generic Panel Driver"
	depends on OF
	depends on DRM_MIPI_DSI
	help
		Say Y here if you want to enable LCD panel driver for Hikey960 boadr.
		Current support panel: NTE300NTS(1920X1200)
```
